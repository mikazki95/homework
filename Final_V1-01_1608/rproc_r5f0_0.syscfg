/**
 * @cliArgs --device "AM64x_beta" --package "ALV" --part "Default" --context "r5fss0-0" --product "MCU_PLUS_SDK_AM64x@08.05.00"
 * @versions {"tool":"1.15.0+2826"}
 */

/**
 * Import the modules used in this configuration.
 */
const ipc        = scripting.addModule("/drivers/ipc/ipc");
const uart       = scripting.addModule("/drivers/uart/uart", {}, false);
const uart1      = uart.addInstance();
const uart2      = uart.addInstance();
const debug_log  = scripting.addModule("/kernel/dpl/debug_log");
const mpu_armv7  = scripting.addModule("/kernel/dpl/mpu_armv7", {}, false);
const mpu_armv71 = mpu_armv7.addInstance();
const mpu_armv72 = mpu_armv7.addInstance();
const mpu_armv73 = mpu_armv7.addInstance();
const mpu_armv74 = mpu_armv7.addInstance();
const mpu_armv75 = mpu_armv7.addInstance();
const mpu_armv76 = mpu_armv7.addInstance();
const mpu_armv77 = mpu_armv7.addInstance();

/**
 * Write custom configuration values to the imported modules.
 */
ipc.enableLinuxIpc = true;

uart1.$name            = "CONFIG_UART0";
uart1.readMode         = "CALLBACK";
uart1.writeMode        = "CALLBACK";
uart1.readCallbackFxn  = "uart_echo_read_callback_1";
uart1.writeCallbackFxn = "uart_echo_write_callback_1";
uart1.readReturnMode   = "PARTIAL";
uart1.UART.$assign     = "USART1";

uart2.$name                   = "CONFIG_UART1";
uart2.useMcuDomainPeripherals = true;
uart2.readMode                = "CALLBACK";
uart2.readCallbackFxn         = "uart_echo_read_callback";
uart2.writeMode               = "CALLBACK";
uart2.writeCallbackFxn        = "uart_echo_write_callback";
uart2.MCU_UART.$assign        = "MCU_USART1";

debug_log.enableCssLog = false;

mpu_armv71.$name             = "CONFIG_MPU_REGION0";
mpu_armv71.size              = 31;
mpu_armv71.attributes        = "Device";
mpu_armv71.accessPermissions = "Supervisor RD+WR, User RD";
mpu_armv71.allowExecute      = false;

mpu_armv72.$name             = "CONFIG_MPU_REGION1";
mpu_armv72.size              = 15;
mpu_armv72.accessPermissions = "Supervisor RD+WR, User RD";

mpu_armv73.$name             = "CONFIG_MPU_REGION2";
mpu_armv73.baseAddr          = 0x41010000;
mpu_armv73.size              = 15;
mpu_armv73.accessPermissions = "Supervisor RD+WR, User RD";

mpu_armv74.$name             = "CONFIG_MPU_REGION3";
mpu_armv74.baseAddr          = 0x70000000;
mpu_armv74.size              = 21;
mpu_armv74.accessPermissions = "Supervisor RD+WR, User RD";

mpu_armv75.$name        = "CONFIG_MPU_REGION4";
mpu_armv75.attributes   = "NonCached";
mpu_armv75.allowExecute = false;
mpu_armv75.size         = 16;
mpu_armv75.baseAddr     = 0xA5000000;

mpu_armv76.$name    = "CONFIG_MPU_REGION5";
mpu_armv76.baseAddr = 0x80000000;
mpu_armv76.size     = 31;

mpu_armv77.$name        = "CONFIG_MPU_REGION6";
mpu_armv77.size         = 20;
mpu_armv77.baseAddr     = 0xA0000000;
mpu_armv77.attributes   = "NonCached";
mpu_armv77.allowExecute = false;

/**
 * Pinmux solution for unlocked pins/peripherals. This ensures that minor changes to the automatic solver in a future
 * version of the tool will not impact the pinmux you originally saw.  These lines can be completely deleted in order to
 * re-solve from scratch.
 */
uart1.UART.RXD.$suggestSolution     = "ball.E15";
uart1.UART.TXD.$suggestSolution     = "ball.E14";
uart2.MCU_UART.RXD.$suggestSolution = "ball.C9";
uart2.MCU_UART.TXD.$suggestSolution = "ball.D9";
